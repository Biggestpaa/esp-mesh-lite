## examples/no_router/main/Kconfig.projbuild
```kconfig
menu "Example Configuration"

    config MESH_ROOT
        select JOIN_MESH_IGNORE_ROUTER_STATUS
        bool "Root device"
        default n
        help
            Configure the root device type.

    config MESH_CHANNEL
        int "Mesh network channel"
        range 1 14
        default 11
        help
            Mesh network channel.

    config UART_BAUD
        int "UART baud rate"
        default 115200

    config UART_RX_GPIO
        int "UART RX GPIO"
        default 16

    config UART_TX_GPIO
        int "UART TX GPIO"
        default 17

    config UDP_PORT
        int "UDP port for leaf->root forwarding"
        default 4510

    config MAX_LINE_LEN
        int "Max ASCII line length (bytes, excluding '\\n')"
        default 100

endmenu
```

## examples/no_router/sdkconfig.defaults.leaf
```kconfig
# Common
CONFIG_MESH_LITE_ENABLE=y
CONFIG_MESH_LITE_NODE_INFO_REPORT=y
CONFIG_BRIDGE_SOFTAP_SSID_END_WITH_THE_MAC=y

# Leaf role
# (CONFIG_MESH_ROOT is NOT set)

# Your bridge settings
CONFIG_MESH_CHANNEL=11

# UART bridge (S3)
CONFIG_UART_BAUD=115200
CONFIG_UART_RX_GPIO=16
CONFIG_UART_TX_GPIO=17

# UDP forwarding
CONFIG_UDP_PORT=4510
CONFIG_MAX_LINE_LEN=100

#Max Layers
CONFIG_MESH_LITE_MAXIMUM_LEVEL_ALLOWED=10
```
